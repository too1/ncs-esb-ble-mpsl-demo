## CMakeLists.txt
```
#
# Copyright (c) 2019 Nordic Semiconductor
#
# SPDX-License-Identifier: LicenseRef-Nordic-5-Clause
#
cmake_minimum_required(VERSION 3.20.0)

find_package(Zephyr REQUIRED HINTS $ENV{ZEPHYR_BASE})
project(NONE)

target_sources(app PRIVATE
  src/main.c
  ../common/app_bt_lbs.c
)

if(CONFIG_SOC_NRF5340_CPUAPP)
  target_sources(app PRIVATE 
    ../common/53_app/app_esb_53_app.c)
else()
  # If we don't build for 5340 appcore, assume a 52 series board is selected
  target_sources(app PRIVATE 
    ../common/app_esb.c
    ../common/timeslot_handler.c)
endif()

zephyr_library_include_directories(../common)
```

## prj.conf
```kconfig
#
# Copyright (c) 2019 Nordic Semiconductor
#
# SPDX-License-Identifier: LicenseRef-Nordic-5-Clause
#

CONFIG_NCS_SAMPLES_DEFAULTS=y

CONFIG_CONSOLE_SUBSYS=y
CONFIG_CONSOLE_HANDLER=y
CONFIG_CONSOLE_GETCHAR=y

CONFIG_BT=y
CONFIG_BT_PERIPHERAL=y
CONFIG_BT_DEVICE_NAME="Nordic_MPSL_LBS"

# Enable the LBS service
CONFIG_BT_LBS=y
CONFIG_BT_LBS_POLL_BUTTON=y

CONFIG_LOG=y
CONFIG_LOG_MODE_DEFERRED=y

CONFIG_SYSTEM_WORKQUEUE_STACK_SIZE=2048

CONFIG_RING_BUFFER=y

CONFIG_DK_LIBRARY=y

CONFIG_MPSL=y
CONFIG_MPSL_TIMESLOT_SESSION_COUNT=2

CONFIG_DYNAMIC_INTERRUPTS=y
CONFIG_DYNAMIC_DIRECT_INTERRUPTS=y

CONFIG_ESB=y
CONFIG_ESB_DYNAMIC_INTERRUPTS=y
```

## boards/nrf52dk_nrf52832.conf
```kconfig
CONFIG_MPSL=y
CONFIG_MPSL_TIMESLOT_SESSION_COUNT=2
```

## boards/nrf5340dk_nrf5340_cpuapp.conf
```kconfig
# ESB can not run from the 5340 appcore directly, instead the app_esb interface will be used
CONFIG_ESB=n
CONFIG_ESB_DYNAMIC_INTERRUPTS=n

CONFIG_MPSL=n

# Enable the RPC library for handling ESB communication between cores
CONFIG_NRF_RPC=y
CONFIG_NRF_RPC_CBOR=y
CONFIG_THREAD_CUSTOM_DATA=y
CONFIG_NRF_RPC_THREAD_STACK_SIZE=4096

# Increase the heap size, as the default IPC transport for
# nRF RPC is just doing standard mallocs.
CONFIG_HEAP_MEM_POOL_SIZE=8192

# Disable the default HCI_RPMSG child image for the netcore
CONFIG_NCS_INCLUDE_RPMSG_CHILD_IMAGE=n
CONFIG_BOARD_ENABLE_CPUNET=y
```

## boards/nrf5340dk_nrf5340_cpunet.conf
```kconfig
CONFIG_MPSL=y
CONFIG_MPSL_TIMESLOT_SESSION_COUNT=2
CONFIG_RING_BUFFER=y

# BT HCI over RPMSG config (start)
# from ncs/zephyr/samples/bluetooth/hci_rpmsg/prj.conf
CONFIG_IPC_SERVICE=y
CONFIG_MBOX=y

CONFIG_HEAP_MEM_POOL_SIZE=8192

CONFIG_MAIN_STACK_SIZE=4096
CONFIG_BT=y
CONFIG_BT_HCI_RAW=y
CONFIG_BT_MAX_CONN=4
CONFIG_BT_CTLR_ASSERT_HANDLER=y
CONFIG_BT_HCI_RAW_RESERVE=1

# Workaround: Unable to allocate command buffer when using K_NO_WAIT since
# Host number of completed commands does not follow normal flow control.
CONFIG_BT_BUF_CMD_TX_COUNT=10

# BT HCI over RPMSG config (end)

# Enable the RPC library for handling ESB communication between cores
CONFIG_NRF_RPC=y
CONFIG_NRF_RPC_CBOR=y
CONFIG_THREAD_CUSTOM_DATA=y
CONFIG_NRF_RPC_THREAD_STACK_SIZE=4096

CONFIG_DK_LIBRARY=n
```

## boards/nrf52833dk_nrf52833.overlay
```dts
// To get started, press Ctrl+Space to bring up the completion menu and view the available nodes.

// You can also use the buttons in the sidebar to perform actions on nodes.
// Actions currently available include:

// * Enabling / disabling the node
// * Adding the bus to a bus
// * Removing the node
// * Connecting ADC channels

// For more help, browse the DeviceTree documentation at https://docs.zephyrproject.org/latest/guides/dts/index.html
// You can also visit the nRF DeviceTree extension documentation at https://nrfconnect.github.io/vscode-nrf-connect/devicetree/nrfdevicetree.html
&uart1 {
	status="disabled";
};
```

## src/main.c
```c
/*
 * Copyright (c) 2019 Nordic Semiconductor ASA
 *
 * SPDX-License-Identifier: LicenseRef-Nordic-5-Clause
 */

/*
MODIFIED SAMPLE TO INCLUDE EXTENSIONS ++
*/

#include <zephyr/kernel.h>
#include <zephyr/console/console.h>
#include <string.h>
#include <zephyr/sys/printk.h>
#include <zephyr/types.h>
#include <zephyr/logging/log.h>

#include <zephyr/drivers/gpio.h> 

#include "app_bt_lbs.h"

#include "app_esb.h"

LOG_MODULE_REGISTER(main, LOG_LEVEL_INF);

void on_esb_callback(app_esb_event_t *event)
{
	static uint32_t last_counter = 0;
	static uint32_t counter;
	switch(event->evt_type) {
		case APP_ESB_EVT_TX_SUCCESS:
			LOG_INF("ESB TX success");
			break;
		case APP_ESB_EVT_TX_FAIL:
			LOG_INF("ESB TX failed");
			break;
		case APP_ESB_EVT_RX:
			memcpy((uint8_t*)&counter, event->buf, sizeof(counter));
			if(counter != (last_counter + 1)) {
				LOG_WRN("Packet content error! Counter: %i, last counter %i", counter, last_counter);
			}
			LOG_INF("ESB RX: 0x%.2X-0x%.2X-0x%.2X-0x%.2X", event->buf[0], event->buf[1], event->buf[2], event->buf[3]);
			last_counter = counter;
			break;
		default:
			LOG_ERR("Unknown APP ESB event!");
			break;
	}
}

int main(void)
{
	int err;

	LOG_INF("ESB PRX BLE Multiprotocol Example");
	
	err = app_bt_init();
	if (err) {
		LOG_ERR("app_bt init failed (err %d)", err);
		return err;
	}

	err = app_esb_init(APP_ESB_MODE_PRX, on_esb_callback);
	if (err) {
		LOG_ERR("app_esb init failed (err %d)", err);
		return err;
	}

	while (1) {
		k_sleep(K_MSEC(2000));
	}

	return 0;
}
```
